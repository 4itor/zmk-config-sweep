## config/west.yml
```yaml
manifest:
  remotes:
    # ZMK Official firmware
    - name: zmkfirmware
      url-base: https://github.com/zmkfirmware
    # ZMK tri-state
    - name: dhruvinsh
      url-base: https://github.com/dhruvinsh
    # RGB Led
    - name: caksoylar
      url-base: https://github.com/caksoylar
    # Raytac Dongle
    - name: rschenk
      url-base: https://github.com/rschenk
  projects:
    - name: zmk
      remote: zmkfirmware
      revision: main
      import: app/west.yml
    - name: zmk-tri-state
      remote: dhruvinsh
      revision: main
    - name: zmk-rgbled-widget
      remote: caksoylar
      revision: main
    - name: zmk-component-raytac-dongle
      remote: rschenk
      revision: main
  self:
    path: config
```
